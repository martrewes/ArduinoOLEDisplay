/*
  TODO
  Add the ticker to artist and album | Changed focus to multiline
  get data to serial port some how with app (Done, sort of)
  see from there.

*/
//Include libraries
#include <Arduino.h>
#include <U8g2lib.h>

//Choose protocol for OLED
#ifdef U8X8_HAVE_HW_SPI
#include <SPI.h>
#endif
#ifdef U8X8_HAVE_HW_I2C
#include <Wire.h>
#endif

//Set display
U8G2_SH1106_128X64_NONAME_F_HW_I2C display(U8G2_R0, /* reset=*/ U8X8_PIN_NONE);

  int dummy = 0;

// 'Background, 128x64px  | Modified icons slightly left by 2px
static unsigned char bpBG [] = {
0x24, 0x49, 0x92, 0x24, 0x49, 0x92, 0x24, 0x49, 0x92, 0x24, 0x49, 0x92, 
  0x24, 0x49, 0x92, 0x24, 0x01, 0x00, 0x00, 0x00, 0x00, 0x00, 0x00, 0x00, 
  0x00, 0x00, 0x00, 0x00, 0x00, 0x00, 0x00, 0x80, 0x00, 0x00, 0x00, 0x00, 
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  0x92, 0x24, 0x49, 0x92, };

//Define strings. "C" versions are used as copies to repeatedly manipulate
String songName;
String songName2;
String songNameC;
String songArtist;
String songArtist2;
String songArtistC;
String songAlbum;
String songAlbum2;
String songAlbumC;
String strArr;

void setup(void) {
  //Init display and serial
	display.begin();  
  display.clear();
	display.clearDisplay();
	Serial.begin(9600);
	Serial.println("Ready to display.");
}

void loop(void) {
  
  //Set up vertical locations of strings. Removed from setup so they reset on every loop.
  int intSN = 14;
  int intSN2 = 18;
  int intSAr = 34;
  int intSAr2 = 38;
  int intSAl = 54;
  int intSAl2 = 58;
	while(Serial.available()) {
    strArr = Serial.readString();// read the incoming data as string
    //Serial.println(strArr);
    //Create indexes to then be used to split the string up into three
		int delimiter, delimiter_1, delimiter_2, delimiter_3;
		delimiter = strArr.indexOf("|");
		delimiter_1 = strArr.indexOf("|", delimiter + 1);
		delimiter_2 = strArr.indexOf("|", delimiter_1 +1);
		delimiter_3 = strArr.indexOf("|", delimiter_2 +1);
		songName = strArr.substring(delimiter + 1, delimiter_1);
		songArtist = strArr.substring(delimiter_1 + 1, delimiter_2);
		songAlbum = strArr.substring(delimiter_2 + 1, delimiter_3);
    //Create copies to be used again (no serial)
    songNameC = songName;
    songArtistC = songArtist;
    songAlbumC = songAlbum;
    //Serial.println(songName);
    //Serial.println(songArtist);
    //Serial.println(songAlbum);  
					
	}
//Font is 5x7 as it's the smallest readable font on the display.
display.setFont(u8g2_font_5x7_tr);
//Bring back the copies
songName = songNameC;
songArtist = songArtistC;
songAlbum = songAlbumC;
/*
Try to explain how this works:
So, due to the fact that the u8g2 library in this form does not support word wrapping, I needed
to find a way to do it myself. The code below (although very spaghetti like) does allow me to 
do this. I will try going though each case to explain it.
At first, I just wanted to split the strings into 2 if required, but I realised quickly this looked
hideous. So I added hyphons, which then showed that it looked studpid if there was only one letter 
left. I then also realised if there was only one letter before it looked studpid. So here are what
each stage does:
First off, the string has to be over 21 characters long, then
First we have to shift the location of the string upwards to allow for space for the second line.
 1. If there is a letter in character 20 & there is a space in character 19, then just shift it	
	  all down
 2. Else, if there is a letter in character 21 & there is a space in character 22, then remove the
	  space, and shift down everything after it (so I can use the max possible space)
 3. Else, if there is just a letter in character, shift it down and inset a hyphon
 4. Else just display both after split

If the string is less than 21 characters, then we just leave the string as it is, and leave it's 
location to the default.
~~Hopefully this makes sense to my future self.
*/
if (songName.length() > 21) {					//Set up for splitting
		intSN = 10;
    if (isAlpha(songName.charAt(19)) && isSpace(songName.charAt(18))) {
      songName2 = songName.substring(19,60);
      songName.remove(19,songName.length() - 19);
    }
    //Also account for a two letter word before
    else if (isAlpha(songName.charAt(20)) && isSpace(songName.charAt(19))) {
      songName2 = songName.substring(20,60);
      songName.remove(19,songName.length() - 19);
    }
		else if (isAlpha(songName.charAt(20)) && isSpace(songName.charAt(21))) {
      songName2 = songName.substring(22,60);
      songName.remove(21,songName.length() - 21);
    }
    else if (isalpha(songName.charAt(20))) {
      songName2 = songName.substring(20,60);
      songName.remove(20,songName.length() - 20);
      songName = songName + "-";
      
    }
    else{
      songName2 = songName.substring(21,60);
      songName.remove(21,songName.length() - 20);
    }

    }	    
else{
    songName2 = "";
    }
    
    //Serial.println(songName2);
    //Serial.println(songName); 

if (songArtist.length() > 21) {					//Set up for splitting
		intSAr = 30;
    if (isAlpha(songArtist.charAt(19)) && isSpace(songArtist.charAt(18))) {
      songArtist2 = songArtist.substring(19,60);
      songArtist.remove(19,songArtist.length() - 19);
    }
		else if (isAlpha(songArtist.charAt(20)) && isSpace(songArtist.charAt(21))) {
      songArtist2 = songArtist.substring(22,60);
      songArtist.remove(21,songArtist.length() - 21);
    }
    else if (isalpha(songArtist.charAt(20))) {
      songArtist2 = songArtist.substring(20,60);
      songArtist.remove(20,songArtist.length() - 20);
      songArtist = songArtist + "-";
      
    }
    else{
      songArtist2 = songArtist.substring(21,60);
      songArtist.remove(21,songArtist.length() - 20);
    }

    }	    
else{
    songArtist2 = "";
    }

if (songAlbum.length() > 21) {					//Set up for splitting
		intSAl = 50;
    if (isAlpha(songAlbum.charAt(19)) && isSpace(songAlbum.charAt(18))) {
      songAlbum2 = songAlbum.substring(19,60);
      songAlbum.remove(19,songAlbum.length() - 19);
    }
    else if (isSpace(songAlbum.charAt(19))) {
      songAlbum2 = songAlbum.substring(19,60);
      songAlbum.remove(19,songAlbum.length() - 19);
    }
		else if (isAlpha(songAlbum.charAt(20)) && isSpace(songAlbum.charAt(21))) {
      songAlbum2 = songAlbum.substring(22,60);
      songAlbum.remove(21,songAlbum.length() - 21);
    }
    else if (isalpha(songAlbum.charAt(20))) {
      songAlbum2 = songAlbum.substring(20,60);
      songAlbum.remove(20,songAlbum.length() - 20);
      songAlbum = songAlbum + "-";
      
    }
    else{
      songAlbum2 = songAlbum.substring(21,60);
      songAlbum.remove(21,songAlbum.length() - 20);
    }

    }	    
else{
    songAlbum2 = "";
    }

	display.clearBuffer();   
	display.drawXBM(0,0,128,64,bpBG);
	display.setCursor(22,intSN);		
	display.println(songName);
	display.setCursor(22,intSN2);
	display.print(songName2);
	display.setCursor(22,intSAr);		
	display.println(songArtist);
	display.setCursor(22,intSAr2);
	display.print(songArtist2);
  display.setCursor(22,intSAl);		
	display.println(songAlbum);
	display.setCursor(22,intSAl2);
	display.print(songAlbum2);

	//display.print(dummy); //Print the ticker so I know the controller is still running
	display.sendBuffer();
	//dummy++;
	delay(100); 

}
// testing git